## conf/layer.conf
```bitbake
# We have a conf directory, add to BBPATH.
BBPATH =. "${LAYERDIR}:"

# We have recipes-* directories, add to BBFILES
BBFILES += " \
    ${LAYERDIR}/recipes-*/*/*.bb \
    ${LAYERDIR}/recipes-*/*/*.bbappend \
"

BBFILE_COLLECTIONS += "murphy"
BBFILE_PATTERN_murphy := "^${LAYERDIR}/"
BBFILE_PRIORITY_murphy = "6"

# Corresponds to bblayers.conf.sample.
LAYERDEPENDS_murphy = " \
    core \
    openembedded-layer \
"

META_MURPHY_BASE := '${LAYERDIR}'

SUPPORTED_RECIPES_append = " \
    ${META_MURPHY_BASE}/conf/distro/include/murphy-supported-recipes.txt \
"
```
